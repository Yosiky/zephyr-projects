## CMakeLists.txt
```
cmake_minimum_required(VERSION 3.20.0)

find_package(Zephyr REQUIRED HINTS $ENV{ZEPHYR_BASE})
project(kconfig_devicetree)

target_sources(app PRIVATE src/main.c)
```

## Kconfig
```
mainmenu "Zephyr learning application"

config COURSE_TICK_PERIOD_MS
    int "Application tick period in milliseconds"
    range 100 5000
    default 500
    help
      Period used by the application's periodic policy.

source "Kconfig.zephyr"
```

## prj.conf
```kconfig
CONFIG_LOG=y
CONFIG_LOG_DEFAULT_LEVEL=3

CONFIG_COURSE_TICK_PERIOD_MS=1200
```

## app.overlay
```dts
/ {
    aliases {
        course-console = &uart0;
    };
};

/ {
    course_cfg: course-config {
        compatible = "course,settings";
        greeting = "RISC-V course";
        tick-period-ms = <250>;
    };
};
```

## dts/bindings/course,settings.yaml
```yaml
description: Configuration for the Zephyr learning application

compatible: "course,settings"

properties:
  greeting:
    type: string
    required: true
  tick-period-ms:
    type: int
    required: true
```

## src/main.c
```c
#include "zephyr/logging/log_core.h"
#include <zephyr/kernel.h>
#include <zephyr/logging/log.h>
#include <zephyr/device.h>
#include <zephyr/devicetree.h>

#define COURSE_CONSOLE_NODE DT_ALIAS(course_console)
#define COURSE_CFG          DT_NODELABEL(course_cfg)

LOG_MODULE_REGISTER(app, LOG_LEVEL_INF);

int main()
{
	LOG_INF("Application started");

	const struct device *console = DEVICE_DT_GET(DT_CHOSEN(zephyr_console));
	if (device_is_ready(console)) {
		LOG_INF("Console device is ready: %s", console->name);
	} else {
		LOG_ERR("Console device is not ready");
	}

	const struct device *course_console = DEVICE_DT_GET(COURSE_CONSOLE_NODE);
	LOG_INF("Course alias: %s", DT_NODE_PATH(COURSE_CONSOLE_NODE));
	LOG_INF("Course console is ready: %d", device_is_ready(course_console));

	LOG_INF("Greeting: %s", DT_PROP(COURSE_CFG, greeting));
	LOG_INF("Configured period: %u ms", DT_PROP(COURSE_CFG, tick_period_ms));
	LOG_INF("Kconfig period: %d ms", CONFIG_COURSE_TICK_PERIOD_MS);

	return 0;
}
```
